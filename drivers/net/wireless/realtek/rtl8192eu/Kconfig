## drivers/net/wireless/realtek/rtl8192eu/Kconfig
```kconfig
config RTL8192EU
	tristate "Realtek RTL8192EU USB Wireless Network Adapter"
	depends on USB && CFG80211
	select WIRELESS_EXT
	select WEXT_PRIV
	select CFG80211_WEXT
	help
	  This option adds the driver for Realtek RTL8192EU 802.11n USB
	  wireless adapters, including:

	    * TP-Link TL-WN823N v2/v3     (USB ID 2357:6109)
	    * Realtek reference board      (USB ID 0bda:818b / 0bda:0179)
	    * ASUS USB-N13 C1              (USB ID 0b05:18f0)
	    * D-Link DWA-131 rev E1        (USB ID 2001:3319)
	    * Edimax EW-7822ULC            (USB ID 7392:b611)

	  This is a Realtek vendor driver port using the cfg80211 wireless
	  stack. It supports STA, AP, and monitor modes.

	  Note: If the adapter is not recognised after loading this module,
	  ensure any conflicting in-tree rtlwifi/rtl8xxxu driver is
	  blacklisted:
	    echo "blacklist rtl8xxxu" | sudo tee /etc/modprobe.d/rtl8192eu.conf

	  To improve USB suspend stability on laptops, set:
	    options 8192eu rtw_power_mgnt=1 rtw_enusbss=0

	  To compile this driver into the kernel, choose Y here.
	  To compile it as a module (recommended), choose M here.
```
